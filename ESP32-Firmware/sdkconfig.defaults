## ESP32-Firmware/sdkconfig.defaults
```kconfig
# ESP32-S3 Heap Configuration for FreeRTOS
# This file configures the ESP-IDF settings to increase available heap

# FreeRTOS Configuration
CONFIG_FREERTOS_HZ=1000

# Reduce main task stack size to free up heap (default 8192, reducing to 4096)
CONFIG_ESP_MAIN_TASK_STACK_SIZE=8192

# Reduce system event task stack to free up heap
CONFIG_ESP_SYSTEM_EVENT_TASK_STACK_SIZE=2048

# Enable PSRAM (2MB available on this board)
CONFIG_SPIRAM=y
CONFIG_SPIRAM_SPEED_80M=y
CONFIG_SPIRAM_USE_MALLOC=y
CONFIG_SPIRAM_MALLOC_ALWAYSINTERNAL=16384
CONFIG_SPIRAM_USE_CAPS_ALLOC=y

# Memory optimization
CONFIG_COMPILER_OPTIMIZATION_SIZE=y

# WiFi/BT stack size reduction
CONFIG_ESP_TASK_WDT_TIMEOUT_S=10

# Bluetooth configuration
CONFIG_BTDM_CTRL_HCI_UART_NO=1
CONFIG_BTDM_SCAN_DUPL_TYPE_DEVICE=y
```
